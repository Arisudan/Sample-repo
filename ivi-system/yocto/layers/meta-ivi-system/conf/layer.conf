## ivi-system/yocto/layers/meta-ivi-system/conf/layer.conf
```bitbake
# We have a conf and classes directory, add to BBPATH
BBPATH .= ":${LAYERDIR}"

# We have recipes-* directories, add to BBFILES
BBFILES += "${LAYERDIR}/recipes-*/*/*.bb \
            ${LAYERDIR}/recipes-*/*/*.bbappend"

BBFILE_COLLECTIONS += "meta-ivi-system"
BBFILE_PATTERN_meta-ivi-system = "^${LAYERDIR}/"
BBFILE_PRIORITY_meta-ivi-system = "10"

LAYERDEPENDS_meta-ivi-system = "core"
LAYERSERIES_COMPAT_meta-ivi-system = "kirkstone"
```
